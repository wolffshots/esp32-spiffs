## Kconfig.projbuild
```kconfig
# config vars for esp32-spiffs
menu "wolffshots/esp32-spiffs config"
    config SPIFFS_TAG
        string "spiffs tag"
        default "esp32-spiffs"
        help
            tag for use with esp log library for spiffs library
endmenu
```
